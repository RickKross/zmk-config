## config/boards/shields/ergotravel/Kconfig.defconfig
```kconfig
config ZMK_SPLIT
    default y

config ZMK_KEYBOARD_NAME
    default "Ergotravel"


if SHIELD_ERGOTRAVEL_LEFT

config ZMK_SPLIT_ROLE_CENTRAL
    default y

endif
```

## config/boards/shields/ergotravel_l/Kconfig.defconfig
```kconfig
if SHIELD_ERGOTRAVEL_L

config ZMK_KEYBOARD_NAME
    default "Ergotravel L"

config ZMK_SPLIT_ROLE_CENTRAL
    default y

endif
```

## config/boards/shields/ergotravel_r/Kconfig.defconfig
```kconfig
if SHIELD_ERGOTRAVEL_R

config ZMK_KEYBOARD_NAME
    default "Ergotravel R"

0config ZMK_SPLIT
    default y

endif
```
